## boards/variscite/imx8mp_var_smarc/board.yml
```yaml
boards:
  - name: imx8mp_var_smarc
    full_name: VAR-SMARC-MX8M-PLUS
    vendor: variscite
    socs:
      - name: mimx8ml8
        variants:
          - name: ddr
            cpucluster: m7
```
